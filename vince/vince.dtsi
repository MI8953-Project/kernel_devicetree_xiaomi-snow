#include "spi.dtsi"
#include "android.dtsi"
#include "pinctrl.dtsi"
#include "display.dtsi"
#include "touchscreen.dtsi"
#include "vince-qrd.dtsi" 
#include "power.dtsi"  
#include "battery.dtsi"
#include "regulator.dtsi"
