/{
	qrd_batterydata: qcom,battery-data {
		qcom,batt-id-range-pct = <5>;
		#include "../common/batterydata/Vince-sunwoda-40Kohm-4000mah.dtsi"
		#include "../common/batterydata/Vince-desay-24Kohm-4000mAh.dtsi"
		#include "../common/batterydata/Vince-coslight-50Kohm-4000mah.dtsi"
		/delete-node/ qcom,qrd_msm8937_sku1_2920mah;
	};
};

&pmi8950_charger {
	/delete-property/ qcom,chg-led-sw-controls;
	/delete-property/ qcom,chg-led-support;
	/delete-property/ qcom,external-typec;
	/delete-property/ qcom,typec-psy-name;
	qcom,thermal-mitigation = <3000 2500 2500 2500 1000 1000 0>;
};
&pmi8950_fg {
	qcom,thermal-coefficients = [c8 86 c1 50 d3 37];
	qcom,cold-bat-decidegc = <0>;
	qcom,cool-bat-decidegc = <150>;
	qcom,warm-bat-decidegc = <450>;
};