&mdss_dsi0 {
	qcom,dsi-pref-prim-pan = <&dsi_sc_ili9881c_hd720_video>;
	lab-supply = <&lab_regulator>;
	ibb-supply = <&ibb_regulator>;
	pinctrl-names = "mdss_default", "mdss_sleep";
	pinctrl-0 = <&mdss_dsi_active &mdss_te_active>;
	pinctrl-1 = <&mdss_dsi_suspend &mdss_te_suspend>;

	qcom,platform-te-gpio = <&tlmm 24 0>;
	qcom,platform-reset-gpio = <&tlmm 61 0>;
};

&dsi_truly_hd720_vid {
	qcom,panel-supply-entries = <&dsi_panel_pwr_supply>;
};

&dsi_auo_hd720_vid {
	qcom,panel-supply-entries = <&dsi_panel_pwr_supply>;
};
&dsi_sc_ili9881c_hd720_video{
	qcom,panel-supply-entries = <&dsi_panel_pwr_supply>;
};