#include "spi.dtsi"
#include "android.dtsi"
#include "pinctrl.dtsi"
#include "display.dtsi"
#include "touchscreen.dtsi"
#include "audio.dtsi"
#include "battery.dtsi"
#include "misc.dtsi"
#include "power.dtsi"
#include "regulator.dtsi"
